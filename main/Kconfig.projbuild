## main/Kconfig.projbuild
```kconfig
menu "Marstek BLE Bridge"

    config BRIDGE_WIFI_SSID
        string "WiFi SSID"
        default ""
        help
            Temporary. Provisioning moves to Improv Serial (entered in the web flasher) with a
            SoftAP fallback; until that exists, the credentials are compiled in so the firmware
            can be brought up and tested at all.

    config BRIDGE_WIFI_PASSWORD
        string "WiFi password"
        default ""

    config BRIDGE_WIFI_MAX_TX_POWER
        int "Maximum WiFi transmit power (0.25 dBm units, 8-84)"
        range 8 84
        default 40
        help
            Peak current during transmit scales with this. Boards with a weak 5 V supply - the
            ESP32-CAM family in particular - brown out the moment the radio starts at full power,
            resetting before anything is logged. 40 is 10 dBm, roughly a tenth of the default
            output; 84 is the 21 dBm default. Raise it once the supply is known good, because
            lowering it costs range.

    config BRIDGE_WIFI_POWER_SAVE
        bool "Allow WiFi modem sleep"
        default y
        help
            Off is what the bridge eventually wants: it holds a BLE link and a WebSocket for hours,
            and modem sleep adds latency to every relayed frame for a power saving that is
            irrelevant on a mains-powered device. On when bringing a board up, because the extra
            current draw is one more thing that can push a marginal supply over the edge.

    config BRIDGE_CLAIM_WINDOW_MINUTES
        int "Minutes after boot during which the bridge can be claimed"
        range 1 1440
        default 10
        help
            A freshly flashed bridge has no password, and whoever reaches it first sets one.
            Bounding that to the first few minutes means one left powered on and unclaimed is not
            standing open indefinitely - taking it over later needs physical access to power-cycle
            it.

    config BRIDGE_FALLBACK_AP_SECONDS
        int "Seconds without WiFi before opening a fallback access point"
        range 10 600
        default 30
        help
            A bridge that cannot join the configured network is otherwise mute: it sits wherever
            the storage sits, with no console attached, and there is no way to ask it what went
            wrong. After this long it opens its own access point so it can still be reached and
            reconfigured. It keeps trying to join the real network in the background.

    config BRIDGE_FALLBACK_AP_PASSWORD
        string "Password of the fallback access point"
        default "marstek-bridge"
        help
            At least 8 characters, or the access point will be open to anyone in range. It only
            serves the same web interface, which has its own login - but on an unclaimed bridge
            that login is still up for grabs during the claim window.

    config BRIDGE_STATUS_LED_ENABLED
        bool "Blink a status LED"
        default y

    config BRIDGE_STATUS_LED_GPIO
        int "Status LED GPIO"
        depends on BRIDGE_STATUS_LED_ENABLED
        default 33
        help
            33 is the small red LED on the AI-Thinker ESP32-CAM. Plain development boards usually
            put theirs on 2. Check the board before trusting the blink.

    config BRIDGE_STATUS_LED_ACTIVE_LOW
        bool "Status LED is wired active low"
        depends on BRIDGE_STATUS_LED_ENABLED
        default y
        help
            True for the ESP32-CAM's red LED, which lights when the pin is pulled low.

endmenu
```
